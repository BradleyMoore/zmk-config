## boards/shields/sweep_matrix/Kconfig.defconfig
```kconfig
if SHIELD_SWEEP_MATRIX

# Name must be < 16 chars
config ZMK_KEYBOARD_NAME
    default "SweepMatrix"

endif
```

## boards/shields/sweep_matrix/Kconfig.shield
```kconfig
# Copyright (c) 2025
# SPDX-License-Identifier: MIT

# No whitespace after the comma or in the keyboard name!
config SHIELD_SWEEP_MATRIX
    def_bool $(shields_list_contains,sweep_matrix)
```
