/dts-v1/;

/ {
    chosen {
        zmk,kscan = &kscan0;
        zmk,matrix-transform = &default_transform;
    };

    kscan0: kscan0 {
        compatible = "zmk,kscan-gpio-matrix";

        // Your diodes are from column to row
        diode-direction = "col2row";

        // Rows: D4, D5, D6, D7
        row-gpios = <&pro_micro 4 (GPIO_ACTIVE_HIGH | GPIO_PULL_DOWN)>,
                    <&pro_micro 5 (GPIO_ACTIVE_HIGH | GPIO_PULL_DOWN)>,
                    <&pro_micro 6 (GPIO_ACTIVE_HIGH | GPIO_PULL_DOWN)>,
                    <&pro_micro 7 (GPIO_ACTIVE_HIGH | GPIO_PULL_DOWN)>;

        // Columns: D18, D15, D14, D16, D10
        col-gpios = <&pro_micro 18 GPIO_ACTIVE_HIGH>,
                    <&pro_micro 15 GPIO_ACTIVE_HIGH>,
                    <&pro_micro 14 GPIO_ACTIVE_HIGH>,
                    <&pro_micro 16 GPIO_ACTIVE_HIGH>,
                    <&pro_micro 10 GPIO_ACTIVE_HIGH>;
    };

    default_transform: matrix_transform {
        compatible = "zmk,matrix-transform";
        rows = <4>;
        columns = <5>;

        // 4×5 identity transform (scan order == key order)
        map = <
            0  1  2  3  4
            5  6  7  8  9
            10 11 12 13 14
            15 16 17 18 19
        >;
    };
};