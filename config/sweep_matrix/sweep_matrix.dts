/*
 * Simple 4x5 matrix shield for a Sweep half on nice!nano v2
 */

#include <dt-bindings/zmk/matrix_transform.h>

/ {
    // Tell ZMK which kscan to use
    chosen {
        zmk,kscan = &kscan0;
    };

    kscan0: kscan0 {
        compatible = "zmk,kscan-gpio-matrix";
        diode-direction = "col2row";

        // Rows: top → bottom: D4, D5, D6, D7
        row-gpios =
            <&pro_micro_d 4 (GPIO_ACTIVE_HIGH | GPIO_PULL_DOWN)>,
            <&pro_micro_d 5 (GPIO_ACTIVE_HIGH | GPIO_PULL_DOWN)>,
            <&pro_micro_d 6 (GPIO_ACTIVE_HIGH | GPIO_PULL_DOWN)>,
            <&pro_micro_d 7 (GPIO_ACTIVE_HIGH | GPIO_PULL_DOWN)>;

        // Columns: left → right: D18, D15, D14, D16, D10
        col-gpios =
            <&pro_micro_a 4 GPIO_ACTIVE_HIGH>,  /* D18 / A4 */
            <&pro_micro_a 1 GPIO_ACTIVE_HIGH>,  /* D15 / A1 */
            <&pro_micro_a 0 GPIO_ACTIVE_HIGH>,  /* D14 / A0 */
            <&pro_micro_a 2 GPIO_ACTIVE_HIGH>,  /* D16 / A2 */
            <&pro_micro_d 10 GPIO_ACTIVE_HIGH>; /* D10 */
    };

    // (Optional) matrix transform/layout; you can add it later if you want perfect ordering.
};
